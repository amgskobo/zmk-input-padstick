/*
 * Copyright (c) 2026 amgskobo
 * SPDX-License-Identifier: MIT
 *
 * The peripheral's pad, scripted as (delay-ms type code value sync);
 * nrf52_bsim.keymap has the timeline. A finger that rests still reports its
 * position every 50 ms.
 */

#include "shared.dtsi"

/ {
    pad: pad {
        compatible = "zmk,test-input-script";
        events = <
            /* 4.0 s to 4.5 s: resting right of the center. */
            TOUCH(4000, 800, 512) POS(50, 800, 512) POS(50, 800, 512) POS(50, 800, 512)
            POS(50, 800, 512) POS(50, 800, 512) POS(50, 800, 512) POS(50, 800, 512)
            POS(50, 800, 512) POS(50, 800, 512) POS(50, 800, 512) LIFT(20)
            /* 6.0 s to 12.0 s: resting left of the center, through the outage. */
            TOUCH(1480, 200, 512) POS(50, 200, 512) POS(50, 200, 512) POS(50, 200, 512)
            POS(50, 200, 512) POS(50, 200, 512) POS(50, 200, 512) POS(50, 200, 512)
            POS(50, 200, 512) POS(50, 200, 512) POS(50, 200, 512) POS(50, 200, 512)
            POS(50, 200, 512) POS(50, 200, 512) POS(50, 200, 512) POS(50, 200, 512)
            POS(50, 200, 512) POS(50, 200, 512) POS(50, 200, 512) POS(50, 200, 512)
            POS(50, 200, 512) POS(50, 200, 512) POS(50, 200, 512) POS(50, 200, 512)
            POS(50, 200, 512) POS(50, 200, 512) POS(50, 200, 512) POS(50, 200, 512)
            POS(50, 200, 512) POS(50, 200, 512) POS(50, 200, 512) POS(50, 200, 512)
            POS(50, 200, 512) POS(50, 200, 512) POS(50, 200, 512) POS(50, 200, 512)
            POS(50, 200, 512) POS(50, 200, 512) POS(50, 200, 512) POS(50, 200, 512)
            POS(50, 200, 512) POS(50, 200, 512) POS(50, 200, 512) POS(50, 200, 512)
            POS(50, 200, 512) POS(50, 200, 512) POS(50, 200, 512) POS(50, 200, 512)
            POS(50, 200, 512) POS(50, 200, 512) POS(50, 200, 512) POS(50, 200, 512)
            POS(50, 200, 512) POS(50, 200, 512) POS(50, 200, 512) POS(50, 200, 512)
            POS(50, 200, 512) POS(50, 200, 512) POS(50, 200, 512) POS(50, 200, 512)
            POS(50, 200, 512) POS(50, 200, 512) POS(50, 200, 512) POS(50, 200, 512)
            POS(50, 200, 512) POS(50, 200, 512) POS(50, 200, 512) POS(50, 200, 512)
            POS(50, 200, 512) POS(50, 200, 512) POS(50, 200, 512) POS(50, 200, 512)
            POS(50, 200, 512) POS(50, 200, 512) POS(50, 200, 512) POS(50, 200, 512)
            POS(50, 200, 512) POS(50, 200, 512) POS(50, 200, 512) POS(50, 200, 512)
            POS(50, 200, 512) POS(50, 200, 512) POS(50, 200, 512) POS(50, 200, 512)
            POS(50, 200, 512) POS(50, 200, 512) POS(50, 200, 512) POS(50, 200, 512)
            POS(50, 200, 512) POS(50, 200, 512) POS(50, 200, 512) POS(50, 200, 512)
            POS(50, 200, 512) POS(50, 200, 512) POS(50, 200, 512) POS(50, 200, 512)
            POS(50, 200, 512) POS(50, 200, 512) POS(50, 200, 512) POS(50, 200, 512)
            POS(50, 200, 512) POS(50, 200, 512) POS(50, 200, 512) POS(50, 200, 512)
            POS(50, 200, 512) POS(50, 200, 512) POS(50, 200, 512) POS(50, 200, 512)
            POS(50, 200, 512) POS(50, 200, 512) POS(50, 200, 512) POS(50, 200, 512)
            POS(50, 200, 512) POS(50, 200, 512) POS(50, 200, 512) POS(50, 200, 512)
            POS(50, 200, 512) POS(50, 200, 512) POS(50, 200, 512) POS(50, 200, 512)
            POS(50, 200, 512) LIFT(20)
        >;
    };
};

&split_input {
    device = <&pad>;
};
