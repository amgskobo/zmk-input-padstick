## Kconfig
```kconfig
# Copyright (c) 2026 amgskobo
# SPDX-License-Identifier: MIT

rsource "src/Kconfig"

config ZMK_INPUT_PADSTICK_LOG_LEVEL
    int "zmk-input-padstick log level (0 off, 1 error, 2 warning, 3 info, 4 debug)"
    range 0 4
    default 3
    help
      Logs contain operational state and numeric diagnostics, never input
      contents, user labels, peer addresses or authentication material.
```

## dts/bindings/zmk,input-processor-padstick.yaml
```yaml
# Copyright (c) 2026 The ZMK Contributors
# SPDX-License-Identifier: MIT

description: Convert absolute trackpad reports into joystick-like relative pointer motion

compatible: "zmk,input-processor-padstick"

include: ip_zero_param.yaml

properties:
  x-deadzone:
    type: int
    default: 48
    description: Absolute X counts around the touch origin that report zero motion.

  y-deadzone:
    type: int
    default: 48
    description: Absolute Y counts around the touch origin that report zero motion.

  x-scale:
    type: int
    default: 8
    description: X fine movement scale after the deadzone. 256 is 1.0x.

  y-scale:
    type: int
    default: 8
    description: Y fine movement scale after the deadzone. 256 is 1.0x.

  x-accel-range:
    type: int
    default: 464
    description: X counts after the deadzone used to ramp smoothly from x-scale to x-accel-scale.

  y-accel-range:
    type: int
    default: 464
    description: Y counts after the deadzone used to ramp smoothly from y-scale to y-accel-scale.

  x-accel-scale:
    type: int
    default: 12
    description: X scale reached at the end of x-accel-range. 256 is 1.0x.

  y-accel-scale:
    type: int
    default: 12
    description: Y scale reached at the end of y-accel-range. 256 is 1.0x.

  max-x:
    type: int
    default: 16
    description: Maximum absolute REL_X value emitted by this processor.

  max-y:
    type: int
    default: 16
    description: Maximum absolute REL_Y value emitted by this processor.

  x-center:
    type: int
    default: 512
    description: Fixed X center coordinate used when fixed-center is enabled.

  y-center:
    type: int
    default: 512
    description: Fixed Y center coordinate used when fixed-center is enabled.

  invert-x:
    type: boolean
    description: Invert generated REL_X direction.

  invert-y:
    type: boolean
    description: Invert generated REL_Y direction.

  radial:
    type: boolean
    description: |
      Take the distance from the origin before applying the ramp, then share the
      resulting step out along the two axes.

      Without this the axes are independent: the deadzone is square, and a ramp
      that rises with distance yields less when that distance is split between
      two axes than when it all lands on one, so a diagonal push runs slower
      than a straight one. With it the speed depends only on how far the finger
      has moved, and the deadzone becomes a circle.

      Costs one integer square root and one divide per axis event.

  fixed-center:
    type: boolean
    description: Use x-center and y-center as the joystick origin instead of the touched position.

  suppress-abs:
    type: boolean
    description: Suppress unconverted absolute events so ABS reports do not leak downstream.

  suppress-btn-touch:
    type: boolean
    description: Suppress BTN_TOUCH events after using them to track contact state.

  suppress-btn0:
    type: boolean
    description: Suppress BTN_0 events when the trackpad reports a physical click.
```

## src/Kconfig
```kconfig
# Copyright (c) 2026 amgskobo
# SPDX-License-Identifier: MIT

DT_COMPAT_ZMK_INPUT_PROCESSOR_PADSTICK := zmk,input-processor-padstick

config ZMK_INPUT_PROCESSOR_PADSTICK
	bool
	default $(dt_compat_enabled,$(DT_COMPAT_ZMK_INPUT_PROCESSOR_PADSTICK))
	depends on ZMK_POINTING
	depends on (!ZMK_SPLIT || ZMK_SPLIT_ROLE_CENTRAL)
	select ZMK_LOW_PRIORITY_WORK_QUEUE

config ZMK_INPUT_PADSTICK_MAX_SOURCES
    int "PadStick source index allocation bound (0 = automatic)"
    default 0
    range 0 256
    depends on ZMK_INPUT_PROCESSOR_PADSTICK
    help
      Zero keeps one independent state slot per enabled ZMK input listener,
      with at least one slot. A positive value allocates that many slots per
      PadStick node, indexed by the original global listener index. It must
      exceed every listener index that can select PadStick, including child
      routes. Builds reject a referenced listener outside the bound. Direct
      API callers must also use an index within the selected bound; NULL state
      selects slot zero and an out-of-range index still passes through.

config ZMK_INPUT_PADSTICK_CUSTOM_SETTINGS
    bool "Publish PadStick tuning through custom settings"
    depends on ZMK_INPUT_PROCESSOR_PADSTICK
    depends on ZMK_CUSTOM_SETTINGS_STUDIO_RPC
    help
      DYA Studio exposes each node's deadzones, gains, centers and orientation.
      The shared registry owns persistence. Stock ZMK keeps the runtime API
      without registering a Custom Studio subsystem.
```

## tests/integration/firmware/boards/shields/padstick_test/Kconfig.defconfig
```kconfig
# Copyright (c) 2026 amgskobo
# SPDX-License-Identifier: MIT

if SHIELD_PADSTICK_TEST

config ZMK_KEYBOARD_NAME
    default "Padstick Test"

endif
```

## tests/integration/firmware/boards/shields/padstick_test/Kconfig.shield
```kconfig
# Copyright (c) 2026 amgskobo
# SPDX-License-Identifier: MIT

config SHIELD_PADSTICK_TEST
    def_bool $(shields_list_contains,padstick_test)
```

## tests/integration/module/Kconfig
```kconfig
# Copyright (c) 2026 amgskobo
# SPDX-License-Identifier: MIT

config ZMK_INPUT_PADSTICK_TEST
    bool "Run padstick runtime self-tests"
    depends on ZMK_INPUT_PROCESSOR_PADSTICK
```
